VERSION ""

NS_ :

BS_:

BU_: HMI AEB
VAL_TABLE_ Gear 1 "Forward Position" 0 "Nuetral Position" ;
VAL_TABLE_ Brakes 1 "Brake applied" 0 "Brake not applied" ;
VAL_TABLE_ HMI 3 "Haptic Warning" 2 "Audible Warning" 1 "Visual Warning" 0 "No Warning" ;
VAL_TABLE_ Engine 1 "Engine ON" 0 "Engine OFF" ;

BO_ 262 Gear_Message: 1 HMI
 SG_ Gear_Signal : 0|8@1+ (1,0) [0|1] "" Vector__XXX

BO_ 259 HMI_Message: 1 AEB
 SG_ HMI_Signal : 0|8@1+ (1,0) [0|3] ""  HMI

BO_ 258 EmergencyWarning_Message: 2 AEB
 SG_ Speed_Signal : 8|8@1+ (1,0) [0|220] "" Vector__XXX
 SG_ RADAR_Signal : 0|8@1+ (1,0) [0|3] "" Vector__XXX

BO_ 261 Brake_Mesage: 1 HMI
 SG_ Brake_Signal : 0|8@1+ (1,0) [0|1] "" Vector__XXX

BO_ 257 Acceleration_Message: 1 HMI
 SG_ Acceleration_Signal : 0|8@1+ (1,0) [0|220] "" Vector__XXX

BO_ 256 Engine_Message: 1 HMI
 SG_ Engine_Signal : 0|8@1+ (1,0) [0|1] "" Vector__XXX

EV_ Env_Gear: 0 [0|1] "" 0 1 DUMMY_NODE_VECTOR0 Vector__XXX;

EV_ Env_Zone3: 0 [0|1] "" 0 2 DUMMY_NODE_VECTOR0 Vector__XXX;

EV_ Env_Zone2: 0 [0|1] "" 0 3 DUMMY_NODE_VECTOR0 Vector__XXX;

EV_ Env_Zone1: 0 [0|1] "" 0 4 DUMMY_NODE_VECTOR0 Vector__XXX;

EV_ Env_RADAR: 0 [0|3] "" 0 5 DUMMY_NODE_VECTOR0 Vector__XXX;

EV_ Env_Engine: 0 [0|1] "" 0 6 DUMMY_NODE_VECTOR0 Vector__XXX;

EV_ Env_Brake: 0 [0|1] "" 0 7 DUMMY_NODE_VECTOR0 Vector__XXX;

EV_ Env_ACC: 0 [0|544] "" 0 8 DUMMY_NODE_VECTOR0 Vector__XXX;

BA_DEF_  "BusType" STRING ;
BA_DEF_DEF_  "BusType" "CAN";
VAL_ 259 HMI_Signal 3 "Haptic Warning" 2 "Audible Warning" 1 "Visual Warning" 0 "No Warning" ;
VAL_ Env_Gear 1 "Forward Position" 0 "Nuetral Position" ;
VAL_ Env_Engine 1 "Engine ON" 0 "Engine OFF" ;
VAL_ Env_Brake 1 "Brake applied" 0 "Brake not applied" ;
